## linux-2.6-cloud-2000/arch/powerpc/sysdev/qe_lib/Kconfig
```kconfig
#
# QE Communication options
#

config UCC_SLOW
	bool
	default y if SERIAL_QE
	help
	  This option provides qe_lib support to UCC slow
	  protocols: UART, BISYNC, QMC

config UCC_FAST
	bool
	default y if UCC_GETH || FSL_UCC_TDM
	help
	  This option provides qe_lib support to UCC fast
	  protocols: HDLC, Ethernet, ATM, transparent

config UCC
	bool
	default y if UCC_FAST || UCC_SLOW

config UPC
	bool
	default n
	help
	  This option enable the QE UPC contorller which is
	  MAC peripheral of QUICC Engine block. Needed by
	  FUA.

config QE_USB
	bool
	default y if USB_GADGET_FSL_QE
	help
	  QE USB Controller support
```

## linux-2.6-cloud-2000/drivers/crypto/caam/Kconfig
```kconfig
config CRYPTO_DEV_FSL_CAAM
	tristate "Freescale CAAM-Multicore driver backend (EXPERIMENTAL)"
	depends on FSL_SOC
	help
	  Enables the driver module for Freescale's Cryptographic Accelerator
	  and Assurance Module (CAAM). This module adds support for scatterlist
	  crypto API, and also configures CAAM to operate as a DPAA component.

config CRYPTO_DEV_FSL_CAAM_RINGSIZE
	int "Job Queue ring size"
	depends on CRYPTO_DEV_FSL_CAAM
	range 2 9
	default "9"
	help
	  Select size of Job Queue rings as a power of 2, within the
	  range 2-9 (ring size 4-512).
	  Examples:
		2 => 4
		3 => 8
		4 => 16
		5 => 32
		6 => 64
		7 => 128
		8 => 256
		9 => 512

config CRYPTO_DEV_FSL_CAAM_INTC
	bool "Job Queue interrupt coalescing"
	depends on CRYPTO_DEV_FSL_CAAM
	default y
	help
	  Enable the Job Queue's interrupt coalescing feature.
	  Note: rev. 1 silicon erratum SEC #4 requires this be set.

config CRYPTO_DEV_FSL_CAAM_INTC_COUNT_THLD
	int "Job Queue interrupt coalescing count threshold"
	depends on CRYPTO_DEV_FSL_CAAM_INTC
	range 1 255
	default 255
	help
	  Select number of descriptor completions to queue before
	  raising an interrupt, in the range 1-255. Note that a selection
	  of 1 functionally defeats the coalescing feature, and a selection
	  equal or greater than the job ring size will force timeouts.

config CRYPTO_DEV_FSL_CAAM_INTC_TIME_THLD
	int "Job Queue interrupt coalescing timer threshold"
	depends on CRYPTO_DEV_FSL_CAAM_INTC
	range 1 65535
	default 2048
	help
	  Select number of bus clocks/64 to timeout in the case that one or
	  more descriptor completions are queued without reaching the count
	  threshold. Range is 1-65535.

config CRYPTO_DEV_FSL_CAAM_DC_LIB
	tristate "Freescale CAAM Descriptor Library (EXPERIMENTAL)"
	depends on CRYPTO_DEV_FSL_CAAM
	help
	  Enables the Descriptor Construction Library for use with
	  Freescale's Cryptographic Accelerator and Assurance Module (CAAM).

config CRYPTO_DEV_FSL_CAAM_CRYPTO_API
	tristate "Linux Kernel Scatterlist Crypto API support"
	depends on CRYPTO_DEV_FSL_CAAM_DC_LIB
	select CRYPTO_ALGAPI
	select CRYPTO_AUTHENC
	help
	  Selecting this will offload crypto for users of the
	  scatterlist crypto API (such as the linux native IPSec
	  stack NETKEY) to the SEC4 via a job queue.

config CRYPTO_DEV_FSL_CAAM_DMAXOR_API
	bool "Freescale CAAM XOR support"
	select DMA_ENGINE
	select ASYNC_XOR
	help
	  Selecting this will offload the xor-parity-calculation for
	  users of the Asynchronous Transfers/Trasnforms API (such as
	  md-raid5 driver) to the SEC4.
```

## linux-2.6-cloud-2000/drivers/tdm/Kconfig
```kconfig
#
# TDM subsystem configuration
#

menuconfig TDM
	tristate "TDM support"
	---help---
	  More information is contained in the directory <file:Documentation/tdm/>,
	  especially in the file called "summary" there.
	  If you want TDM support, you should say Y here and also to the
	  specific driver for your bus adapter(s) below.

	  This TDM support can also be built as a module.  If so, the module
	  will be called tdm-core.

if TDM

config TDM_CHARDEV
	tristate "TDM device interface"
	default n
	help
	  Say Y here to use tdm-dev device files, usually found in the /dev
	  directory on your system.  They make it possible to have user-space
	  programs use the TDM device. Information on how to do this is
	  contained in the file <file:Documentation/tdm/dev-interface>.

	  This support is also available as a module.  If so, the module
	  will be called tdm-dev.

config TDM_DEBUG_CORE
	bool "TDM Core debugging messages"
	help
	  Say Y here if you want the TDM core to produce a bunch of debug
	  messages to the system log.  Select this if you are having a
	  problem with TDM support and want to see more of what is going on.

source drivers/tdm/device/Kconfig
source drivers/tdm/line_ctrl/Kconfig
source drivers/tdm/test/Kconfig
endif # TDM
```

## linux-2.6-cloud-2000/drivers/tdm/device/Kconfig
```kconfig
#
# Sensor device configuration
#

menu "TDM Device support"

config TDM_FSL_STARLITE
        tristate "Driver for Freescale Starlite TDM controller"
        depends on FSL_SOC
        ---help---
          This is a driver for Freescale Starlite TDM controller. The controller
          is found in various Freescale SOCs viz MPC8315, P1020. The TDM driver
          basically multiplexes and demultiplexes data from different channels.
          The TDM can interface SLIC kind of devices.

config FSL_UCC_TDM
       tristate "UCC TDM driver for Freescale QE engine"
       depends on FSL_SOC || CONFIG_QE
       ---help---
         This is a driver for Freescale QE UCC working with TDM interface.

endmenu
```

## linux-2.6-cloud-2000/drivers/tdm/line_ctrl/Kconfig
```kconfig
#
# TDM line control driver config file
#


config SLIC_ZARLINK
	tristate "Zarlink Slic intialization Module"
		default n
		---help---
		  This module initialize and configure the zarlink slic
config PQ_MDS_T1
        tristate "PQ MDS T1 CARD SUPPORT"
                default n
               ---help---
                  This module initialize and configure the pq-mds-t1 card
		  in T1 or E1 mode.
```

## linux-2.6-cloud-2000/drivers/tdm/test/Kconfig
```kconfig
#
# TDM line control driver config file
#


config TDM_TEST
        tristate "TDM test Module"
		default n
		---help---
		  This TDM test module is a small test module which
		  registers with the TDM core(framework) and sets up
		  a TDM Voice path between Port 0 and Port 1 for each slic.

config UCC_TDM_TEST
	tristate "UCC TDM test Module"
		default n
		---help---
		This UCC TDM test module is a small test module to test
		ucc tdm transfer and receive data via ucc1.
```
